## boards/shields/azoteq/Kconfig.shield
```kconfig
# Copyright (c) 2022 The ZMK Contributors
# SPDX-License-Identifier: MIT

config SHIELD_AZOTEQ_LEFT
    def_bool $(shields_list_contains,azoteq_left)

config SHIELD_AZOTEQ_LEFT_ENABLE
    def_bool $(shields_list_contains,azoteq_left_enable)

config SHIELD_AZOTEQ_RIGHT
    def_bool $(shields_list_contains,azoteq_right)
```

## boards/shields/iqs5xx/Kconfig.defconfig
```kconfig
if SHIELD_IQS5XX

# Name must be less than 16 characters long!
config ZMK_KEYBOARD_NAME
    default "iqs5xx"

endif
```

## boards/shields/iqs5xx/Kconfig.shield
```kconfig
# No whitespace after the comma or in your keyboard name!
config SHIELD_IQS5XX
    def_bool $(shields_list_contains,iqs5xx)
```

## config/west.yml
```yaml
manifest:
  remotes:
    - name: zmkfirmware
      url-base: https://github.com/zmkfirmware
    - name: mctechnology17 # <-- enable the drivers and this module
      url-base: https://github.com/mctechnology17
  projects:
    - name: zmk
      remote: zmkfirmware
      revision: main
      import: app/west.yml
    - name: azoteq-input-module # <-- enable the drivers
      remote: mctechnology17
      revision: main
    - name: zmk-azoteq-adapter # <-- enable this module
      remote: mctechnology17
      revision: main
  self:
    path: config
```
